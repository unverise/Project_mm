## MTK_6.12/drivers/misc/mediatek/imgsensor/src/Kconfig
```kconfig
config SPECIFY_IMGSENSOR
	bool "Specify image sensor name"
	depends on MTK_IMGSENSOR
	help
	  Specify name of each sensor to prevent obtaining wrong sensor driver
	  with same sensor ID. For example, imx258_mipi_raw and
	  imx258_mipi_mono are of same sensor ID. If not specifying sensor,
	  imx258_mipi_mono may be recognized as imx258_mipi_raw.

config IMGSENSOR_MAIN
	string "Custom main image sensor"
	depends on SPECIFY_IMGSENSOR
	help
	  Specify name of main sensor to prevent obtaining wrong sensor driver
	  with same sensor ID. For example, imx258_mipi_raw and
	  imx258_mipi_mono are of same sensor ID. If not specifying sensor,
	  imx258_mipi_mono may be recognized as imx258_mipi_raw.

config IMGSENSOR_MAIN2
	string "Custom main2 image sensor"
	depends on SPECIFY_IMGSENSOR
	help
	  Specify name of main2 sensor to prevent obtaining wrong sensor driver
	  with same sensor ID. For example, imx258_mipi_raw and
	  imx258_mipi_mono are of same sensor ID. If not specifying sensor,
	  imx258_mipi_mono may be recognized as imx258_mipi_raw.

config IMGSENSOR_SUB
	string "Custom sub image sensor"
	depends on SPECIFY_IMGSENSOR
	help
	  Specify name of sub sensor to prevent obtaining wrong sensor driver
	  with same sensor ID. For example, imx258_mipi_raw and
	  imx258_mipi_mono are of same sensor ID. If not specifying sensor,
	  imx258_mipi_mono may be recognized as imx258_mipi_raw.

config IMGSENSOR_SUB2
	string "Custom sub2 image sensor"
	depends on SPECIFY_IMGSENSOR
	help
	  Specify name of sub2 sensor to prevent obtaining wrong sensor driver
	  with same sensor ID. For example, imx258_mipi_raw and
	  imx258_mipi_mono are of same sensor ID. If not specifying sensor,
	  imx258_mipi_mono may be recognized as imx258_mipi_raw.

config IMGSENSOR_MAIN3
	string "Custom main3 image sensor"
	depends on SPECIFY_IMGSENSOR
	help
	  Specify name of main3 sensor to prevent obtaining wrong sensor driver
	  with same sensor ID. For example, imx258_mipi_raw and
	  imx258_mipi_mono are of same sensor ID. If not specifying sensor,
	  imx258_mipi_mono may be recognized as imx258_mipi_raw.

#ITD:modify by camera driver team start
config TRAN_CAMERA_EXT_LDO_REGULATOR
    bool "camera use ext ldo"
    default n
    help
      camera use ext ldo, no isp, no hal

config TRAN_CAM_BUCK_FOR_VS2
    bool "camera use vs2 pmu"
    default n
    help
      camera use vs2 pmu, no isp, no hal

config TRAN_LCM_4CH_LDO
        bool "camera use lcm 4ch ldo"
        default n
        help
          camera use lcm 4ch ldo, no isp, no hal

config TRAN_CAMERA_FAKE_STEREO_MAIN2
    bool "use fake stereo main2"
    default n
    help
    use fake stereo main2, no isp, no hal

config TRAN_CAMERA_FAKE_STEREO_SUB2
    bool "use fake stereo sub2"
    default n
    help
    use fake stereo sub2, no isp, no hal

config TRAN_CAMERA_FAKE_STEREO_MAIN3
    bool "use fake stereo main3"
    default n
    help
    use fake stereo main3, no isp, no hal

config TRAN_CAMERA_FAKE_STEREO_MAIN4
    bool "use fake stereo main4"
    default n
    help
    use fake stereo main4, no isp, no hal

config TRAN_CAMERA_FAKE_STEREO_SAME_CLK_WITH_MAIN
    bool "fake stereo sensor. same clk with main sensor"
    default n
    help
    if fake stereo sensor have same clk with main sensor, must skip clk enable

config TRAN_CAMERA_FAKE_STEREO_SAME_CLK_WITH_MAIN_SEC
    bool "fake stereo sec sensor. same clk with main sensor"
    default n
    help
    if fake stereo sec sensor have same clk with main sensor, must skip clk enable

config TRAN_CAMERA_FAKE_STEREO_SAME_AVDD_WITH_MAIN
        bool "fake stereo sensor. same avdd with main sensor"
        default n
        help
          if fake stereo sensor have same avdd with main sensor, must skip avdd enable

config MTK_CAM_MAX_NUMBER_OF_CAMERA
        int "max number of camera supported"
        default 2
        help
          max number of camera supported

config CONFIG_TRAN_CAMERA_BIND_SN
		bool "read camera sn number"
        default n
        help
          read camera sn number
config CUSTOM_TRAN_DRIVER_GC8034_27FPS
        bool "gc8034 driver 27fps flag"
        default n
        help
          use CUSTOM_TRAN_DRIVER_GC8034_27FPS

#add by fei.wu5 for 4LDO compatible 20240717 start
config REGULATOR_TRAN_4CH_LDO_SGM38121_SUPPORT
    bool "camera use sgm38121 4ldo"
    default n
    help
      camera use sgm38121 4ldo
#add by fei.wu5 for 4LDO compatible 20240717 end

config TRAN_CAMERA_REGULATOR_SUPPORT
    bool "camera pin is configured as regulator"
 	default n
 	help
 	  camera pin is configured as regulator, no isp, no hal

config CUSTOM_TRAN_PROJECT
    string "CUSTOM_TRAN_PROJECT"
 	help
 	   Kernel space PROJECT version.

#ITD: Modify sensor control parallel By yingfei.li 240227 start
config TRAN_CAM_SENSOR_PARALLELISM
        bool "sensor control parallelism"
        default n
        help
            if enable, Sensor control can be parallel
#ITD: Modify sensor control parallel By yingfei.li 240227 end
#ITD:modify by camera driver team end

#ITD: Add Imgsensor Info By hongtao.xie 20250219 start
config TRAN_IMGSENSOR_HAVE_SUB2
		bool "match sub2 device name"
        default n
        help
          match sub2 device name
#ITD: Add Imgsensor Info By hongtao.xie 20250219 start
```

## MTK_6.12/drivers/misc/mediatek/ops_mediator/Kconfig
```kconfig
config TRAN_OPS_MEDIATOR
    tristate "TRANSSION TP Notifier driver"
    help
      This driver is the bridge between TP and LCD, LCD can get TP mode from This
      driver,LCD also get notify TP to go to sleep or resume.
config TRAN_FTS_PATCH_COMERR_PM
    bool "TRANSSION Focal tp add pm patch"
    help
      For communication err in deep sleep.
```

## MTK_6.12/drivers/misc/mediatek/sensor/2.0/sensorhub/Kconfig
```kconfig
config MTK_SENSORHUB
	tristate "sensorhub architecture for MediaTek package"
	help
	  It support mediatek sensorhub architecture.
	  If this option is set,
	  it will support
	  mediatek sensorhub architecture.
config MTK_SENSOR_LEGACY_SUPPORT
	tristate "sensorhub legacy support for LP"
	help
	  It support mediatek sensorhub legacy feature support.
	  If this option is set,
	  it will support
	  mediatek sensorhub legacy features.
```

## MTK_6.12/drivers/misc/tran_power_ctrl/Kconfig
```kconfig
config TRAN_POWER_CTRL
    tristate "TRAN_POWER_CTRL"
    default m
    help
      Enable TRAN_POWER_CTRL build

config ENABLE_TRAN_POWER_CTRL
    bool "ENABLE_TRAN_POWER_CTRL"
    default y
    help
      Enable CPU Usage log on dmesg

config TRAN_KERNEL_FANS_SUPPORT
    bool "SPD_TI kernel fans macro"
    default n
    help
      This macro contains the following functions
      which developed by TRANSSION SPD_TI Group.

config TRAN_ODPM_MD_SWITCH
    bool "TRAN_ODPM_MD_SWITCH"
    default n
    help
      Switch for ODPM and MD sleep
```

## MTK_6.12/drivers/misc/tranlog/Kconfig
```kconfig
config TRAN_TRANLOG
    tristate "transsion logger driver"
    default m
    help
       transsion logger driver
```

## MTK_6.12/drivers/misc/transsion/Kconfig
```kconfig
#Transsion Top Secret
#
#Copyright (C) 2019 Transsion Inc.
#
#@author zhongyu.shi
#@version 1.0, 2019-06-03
#
config TRAN_TNEK_SUPPORT
    tristate "Enable Transsion New Engine Kernel Driver"
    default m
    help
      TNEK is created by SPD_TI group to collect crash in Kernel,
      and export an api to collect debug info.
config TRAN_FREEZE_DETECT_SUPPORT
    tristate "Enable tran freeze detect"
    default y
    help
      tran freeze detect driver

config TRAN_HUNG_DETECT
    tristate "transsion hung detect driver"
    default m
    help
       transsion hung detect driver

config TRAN_FREEZE_AEGIS_SUPPORT
    tristate "Enable tran aggis"
    default y
    help
       transsion aegis driver

#USD: add GPIO SAR monitor by ningninggao 20241114 start
config TRAN_GPIO_SAR_MONITOR_MODULE
    tristate "transsion GPIO SAR monitor"
        default n
        help
            transsion GPIO SAR monitor
#USD: add GPIO SAR monitor by ningninggao 20241114 end
```

## MTK_6.12/drivers/power/supply/transsion/wireless/Kconfig
```kconfig
config CHARGER_CPS4021
	tristate "Charger Driver for cps4021 Charger IC"
	default n
    depends on TC_CHARGER

config CHARGER_MT5728
	tristate "Charger Driver for mt5728 Charger IC"
	default n
    depends on TC_CHARGER

config WIRELESS_MANAGER
	tristate "Charger Driver for wireless common algo"
	default n
    depends on TC_CHARGER

config TRAN_WIRELESS_TA
	tristate "Charger Driver tran wireless ta"
	default n
    depends on TC_CHARGER

config TRAN_REVERSE_PRIVATE
	tristate "Charger Driver tran wireless ta"
	default n
    depends on TC_CHARGER
	
```

## MTK_6.12/drivers/soc/mediatek/vadsp/Kconfig
```kconfig
config MTK_VIRT_ADSP
	tristate "Mediatek Auto Virtio ADSP Device"
	bool "Support virtio adsp  mode"
	depends on SND_VIRTIO
	help
	  This is MTK virt adsp driver.
	  Say Y if you would like to enable virt adsp,
	  If unsure, say N.
	  The auto product with hypervisor guest os use virtio adsp device.
```

## MTK_6.12/drivers/tee/Kconfig
```kconfig
# SPDX-License-Identifier: GPL-2.0-only
# Generic Trusted Execution Environment Configuration
if TEE

menu "TEE drivers"

config MTK_TEE_GP_SUPPORT
	bool "Enable MTK GlobalPlatform support in TEE related modules"
	default n
	depends on (TRUSTONIC_TEE_SUPPORT) || (MICROTRUST_TEE_SUPPORT)
	help
	  GlobalPlatform defines common/consistent APIs and this option
	  enables TEE related modules to use GPAPIs. (depending on
	  Trustonic TEE Support or Microtrust TEE Support or Google Trusty
	  TEE or other 3rd-party TEE)

#USD:add for tos panic by tie.huang 20250614 start
config TRAN_TOSPANIC_DEBUG_SUPPORT
	tristate "Enable Transsion tos panic debug"
	depends on TRAN_TNEK_SUPPORT
	default m
	help
	  tran tos panic debug info.
#USD:add for tos panic by tie.huang 20250614 end

source "$(KCONFIG_EXT_PREFIX)drivers/tee/teeperf/Kconfig"
source "$(KCONFIG_EXT_PREFIX)drivers/tee/gud/Kconfig"
source "$(KCONFIG_EXT_PREFIX)drivers/tee/teei/Kconfig"
endmenu

endif
```

## MTK_6.12/drivers/thermal/transsion/Kconfig
```kconfig
config TRAN_VTSHELL_THERMAL
	tristate "virtual tshell driver for Mediatek"
	depends on THERMAL_OF
	default m
	help
	  Enable this option if you want to get virtual tshell temperature
	  via vitrual tshell for Mediatek platforms.
	  This driver collects other sensor temperature with coefficient to calculate
	  virtual tshell temperatrure.

config TRAN_THERMAL_INTERFACE
	tristate "kernel interface for transsion thermal"
	depends on TC_CLASS_SUPPORT
	default m
	help
	  Enable this option if you want to get thermal feature
	  via thermal interface for Mediatek platforms.
```

## MTK_6.12/drivers/ufs/vendor/Kconfig
```kconfig
config UFSFEATURE
	bool "UFS feature activate"
	depends on SCSI_UFSHCD
	help
	  UFS feature activate such as hpb, tw and etc.

config UFSSHPB
	bool "UFS Samsung Host Performance Booster support"
	depends on SCSI_UFSHCD && UFSFEATURE
	help
	  UFS HPB Feature Enable

config HPB_DEBUG
	bool "HPB Debug Log Enable"
	depends on SCSI_UFSHCD && UFSFEATURE && UFSSHPB
	default n
	help
	  UFS HPB Debug Enable (dmesg log[=if set debug sysfs] & BLK_TRACE msg)

config HPB_DEBUG_SYSFS
	bool "HPB Debug sysfs"
	depends on SCSI_UFSHCD && UFSFEATURE && UFSSHPB
	default n
	help
	  UFS HPB Debug Sysfs Enable

config HPB_ERR_INJECTION
	bool "HPB ERROR INJECTION"
	depends on SCSI_UFSHCD && UFSFEATURE && UFSSHPB
	help
	  error injection for checking HPB entry integrity

config UFSTW
	bool "UFS Turbo Write support"
	depends on SCSI_UFSHCD && UFSFEATURE
	help
	  UFS TW Feature Enable

config UFSTW_IGNORE_GUARANTEE_BIT
	bool "Ignore UFS Turbo Write Life Time Guarantee bit for POC"
	default n
	depends on SCSI_UFSHCD && UFSFEATURE && UFSTW
	help
	  ignore the guarantee bit[31] of dTurboWriteBufferLifeTimeEst for PoC

config UFSTW_BOOT_ENABLED
	bool "Turbo Write enabled at boot time"
	default y
	depends on SCSI_UFSHCD && UFSFEATURE && UFSTW
	help
	  fTurboWriteEn and fTurboWriteBufferFlushDuringHibnerEnter flags
	  are enabled at boot time.

config UFSHID
	bool "UFS Host Initiated Defrag support"
	depends on SCSI_UFSHCD && UFSFEATURE
	help
	  UFS HID Feature Enable

config UFSHID_POC
	bool "UFSHID_POC test"
	depends on SCSI_UFSHCD && UFSFEATURE && UFSHID
	help
	  UFS HID POC test
	  1. block to enter suspend state
	  2. auto_hibern8 enable/disable (HCI)
	  3. set flag bDefragOperation
	  4. debug msg enable (default : disable)

config UFSHID_DEBUG
	bool "HID Debug Enable"
	depends on SCSI_UFSHCD && UFSFEATURE && UFSHID
	default n
	help
	  UFS HID Debug Enable (for check io stat during trigger)

config UFSRINGBUF
	bool "UFS RingBuffer support"
	depends on SCSI_UFSHCD && UFSFEATURE
	help
	  UFS RingBuffer Feature Enable

config UFSRINGBUF_POC
	bool "UFS RingBuffer POC test"
	depends on SCSI_UFSHCD && UFSFEATURE && UFSRINGBUF
	help
	  UFS RingBuffer POC test
	  1. set default vendor_signature & vendor_parameter for test
	  2. Set custom vender_parameter

config UFS_MEDIATEK_INTERNAL
	bool "Mediatek UFS Internal Features"
	depends on SCSI_UFSHCD
	help
	  UFS features or code block that is kept available internally
	  and should not be upstreamed.

config UFS_MEDIATEK_MCQ
	bool "Mediatek Proprietary MCQ Support"
	depends on SCSI_UFSHCD && DEVICE_MODULES_SCSI_UFS_MEDIATEK
	help
	  Enable on platform that implemented MediaTek non-standard MCQ.
	  This require Kernel support on mcq vendor hook like in kernel 5.15.

config UFS_MEDIATEK_MT6893
	bool "Mediatek Proprietary platform 6893 Support"
	depends on SCSI_UFSHCD && DEVICE_MODULES_SCSI_UFS_MEDIATEK
	help
	  Enable on MT6893 where implemented UFS related platform changes.
          This is to be in sync with the perf related changes into it

#STD:add by jinkai.zhang for record_ufs_driver_except 2.0 20250807 start
config TRAN_UFS_ERR_RECORD
	bool "record_ufs_driver_except"
	default y
        depends on SCSI_UFSHCD
	help
	   THE transsion record ufs except
config TRAN_UFS_EXCEPTION_UPLOAD
	bool "record_ufs_except upload switch"
	default y
	depends on SCSI_UFSHCD
	help
	   THE switch for transsion  ufs exception
config TRAN_UFS_EXCEPTION_USE_TNE
	bool "record_ufs_except upload flag switch for user"
	depends on SCSI_UFSHCD
	default y
	help
	   THE user switch for transsion  ufs exception
config TRAN_UFS_ERR_RECORD_DEBUG
	bool "record_ufs_driver_except debug switch"
	default y
	depends on SCSI_UFSHCD
	help
	   THE debug switch for transsion record ufs except
config TRAN_FREEZE_DETECT_SUPPORT
	bool "tran feeze detect support"
	default y
	depends on SCSI_UFSHCD
	help
	   The switch for tran tne upload
#STD:add by jinkai.zhang for record_ufs_driver_except 2.0 20250807 end
```

## tran_mm/tran_zram/6.12/Kconfig
```kconfig
# SPDX-License-Identifier: GPL-2.0
#
# Block device driver configuration
#
source "drivers/block/zram/Kconfig"
```
