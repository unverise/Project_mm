## MTK_6.12/drivers/antcontrol/Kconfig
```kconfig
# SPDX-License-Identifier: GPL-2.0-only
#
# ANTCONTROL drivers configuration
#

source "$(KCONFIG_EXT_PREFIX)drivers/antcontrol/trangpio/Kconfig"
```

## MTK_6.12/drivers/antcontrol/trangpio/Kconfig
```kconfig
# SPDX-License-Identifier: GPL-2.0-only
#
# TRANGPIO GPIO Control Driver
#
#
# Transsion TRANGPIO driver configuration
#

config TRAN_TRANGPIO
    tristate "Transsion TRANGPIO driver"
    depends on PINCTRL
    default n
    help
      This driver provides a character device interface for controlling
      GPIOs via pinctrl states. It allows userspace applications to
      control multiple GPIO pins through a simple read/write interface.
      
      The driver supports:
      - Reading current GPIO states
      - Setting individual or multiple GPIO states
      - Device tree configuration for GPIO mappings
      - Configurable timing parameters
      
      To compile this driver as a module, choose M here: the
      module will be called trangpio.
      
      Debug logging can be controlled at runtime via the debug_enabled
      module parameter without requiring compile-time configuration.

      Say Y here if you want to use TRAN GPIO control functionality.
      Say M to build it as a module (trangpio.ko).

      If unsure, say N.
```

## MTK_6.12/drivers/bootdevice/Kconfig
```kconfig
config TRAN_PROC_BOOTDEVICE
    tristate "TRAN proc bootdevice"
    default m
    help
        create proc/bootdevice dir to record flash info


config TRAN_PROC_UFS
    bool "TRAN proc bootdevice for ufs"
    default y if SCSI_UFSHCD != n
    help
        create proc/bootdevice dir to record flash info


config TRAN_PROC_MMC
    bool "TRAN proc bootdevice for mmc"
    default y if !TRAN_PROC_UFS
    help
        create proc/bootdevice dir to record flash info
```

## MTK_6.12/drivers/hypervisor/vm_uos/Kconfig
```kconfig
# SPDX-License-Identifier: GPL-2.0-only
#
# Virtualization android guest support drivers
#

config HYPER_VM_UOS
	tristate "hypervisor guest android1 os"
	help
	  The hypervisor project is "m".
	  Used for hypervisor guest android1 os.
	  If your code is for hypervisor android os,
	  you can use it to wrap your code.

config VIRTIO_VIDEO_MTK_EXTENSION
	tristate "MTK extensions"
	help
	  This option enables support for MediaTek-specific extensions
	  to the virtio video driver.
	  This is the virtual video driver for virtio.
	  Say Y or M.

config VIRTIO_VIDEO_TRACE_DEBUG
	bool "VIRTIO Video TRACE Debug support"
	depends on VIRTIO_VIDEO_MTK_EXTENSION
	help
	  This is a debug interface for VIRTIO Video
	  Set Y to enable this feature.
	  Set N to disable this feature.
	  If unsure, Set N to disable it.

config DEVICE_MODULES_VIRTIO_VDMABUF
	tristate "DMA-BUF vdmabuf"
	depends on HYPER_VM_UOS
	help
	  Choose this option to enable  vdmabuf feature.
	  vdmabuf is a means of cross-domain shared memory. Its function is
	  to transfer the dmabuf requested by the guest to the host so that
	  both ends can access the same physical mem. This is the
	  configuration of vdmabuf on the guest side.

config VIRTIO_MTK_MMDVFS
	tristate "MediaTek Virtio MMDVFS Support"
	help
	  Say yes here to add support for the MediaTek Multimedia DVFS (MMDVFS)
	  driver in Hypervisor guest OS. The MMDVFS is used to set clk for Mediatek Multimedia hardwares
	  , such as display, camera, mdp and video codec. Say no if your device
	  does not need to do DVFS for Multimedia hardwares.
```

## MTK_6.12/drivers/input/fingerprint/Kconfig
```kconfig
# SPDX-License-Identifier: GPL-2.0-only
#
#Fingerprint
#
menu "Fingerprint support"
	depends on INPUT
config TRAN_FINGERPRINT
	tristate "Tran Fingerprint"
	depends on DEVICE_MODULES_SPI_MT65XX
	default n
	help
	TRAN fingerprint chip.
config TRAN_FINGERPRINT_LEGACY
	tristate "Tran Fingerprint"
	depends on DEVICE_MODULES_SPI_MT65XX
	default n
	help
	TRAN legacy fingerprint chip.
config MTK_FINGERPRINT_SUPPORT
	tristate "Mediatek Fingerprint"
	default n
	help
	  Fingerprint mtk driver enable/disable
	  in the kernel.Say Y here if you want to
	  use mediatek fingerprint driver,fingerprint
	  driver will support fingerprint function

endmenu
source "$(KCONFIG_EXT_PREFIX)/drivers/input/fingerprint/tran_common_v2/Kconfig"
source "$(KCONFIG_EXT_PREFIX)/drivers/input/fingerprint/tran_common/Kconfig"
```

## MTK_6.12/drivers/input/fingerprint/tran_common/Kconfig
```kconfig
menuconfig TRAN_FINGERPRINT_LEGACY
	tristate "transsion class series devices"
	default y

if TRAN_FINGERPRINT_LEGACY

config TRAN_FP_DRV_MODE_SPI
	bool "specify fingerprint driver type --- SPI mode"
	default y
	help
		support for spi mode fingerprint driver

config TRAN_CHIP_PLAT
	string "which chip platform"
	default "MTK"
	help
		in which chip platform

config TRAN_FP_POWER_CTRL_REGULATOR
	bool "transsion fp power controlled by regulator"
	default n
	help
		support for transsion fp power control by regulator

config TRAN_FP_POWER_CTRL_GPIO
	bool "transsion fp power controlled by gpio"
	default n
	help
		support for transsion fp power control by gpio
config TRAN_FP_VENDOR
	string "which vendor does transsion fp support?"
	default "sunwave"
	help
		support for transsion fp vendor control
config TRAN_FP_LOG_LVL
	string "which log level does transsion fp support?"
	default "DEBUG"
	help
		support for transsion fp log output control
config TRAN_FP_ANDROID_VERSION
	string "finger android version"
	default "android_s"
	help
		finger android version
config TRAN_FP_TEE_VERSION
    string "finger TEE version"
    default "500"
    help
        finger_trustonic_version
config TRAN_LHBM_NOTIFY_FINGERPRINT
        tristate "enable hbm state notify fingerprint"
        help
          For fingerprint under the screen projects.
          You need add CONFIG_TRAN_LHBM_NOTIFY_FINGERPRINT=m to tran_custom.config file.
endif
```

## MTK_6.12/drivers/input/keyboard/tran_key/Kconfig
```kconfig
config TRAN_CUSTOM_KEY_EXPAND
  tristate "For tran sw key expand function"
  help
    Select for tran_sw key expand function.
    Set Y or M to select this feature for the item,
    and set N to disable.
```

## MTK_6.12/drivers/input/keyboard/tran_key_bigdata/Kconfig
```kconfig
config TRAN_CUSTOM_KEY_BIGDATA
  tristate "For tran sw key bigdata function"
  help
    Select for tran_sw key bigdata function.
    Set Y or M to select this feature for the item,
    and set N to disable.
```

## MTK_6.12/drivers/input/touchscreen/transsion/vendor/chipone/chipone_tddi_9916x/Kconfig
```kconfig
config TOUCHSCREEN_CHIPONE_9916X
        tristate "CONFIG_TOUCHSCREEN_CHIPONE_9916X"
        default n
        help
          Say Y here if you have line hall.
          If unsure, say N.
          To compile this dirver as a module, choose M here: the
          module will be called.

config TP_VIRTUAL_PROXIMITY
	bool "Chipone TDDI TP proximity"
	default n
        help
          Say Y here to enable Chipone TDDI TP proximity.

          If unsure, say N.

          To compile this dirver as a module, choose M here: the
          module will be called

config CTS_CHARGER_STATUS
        bool "Chipone charger status"
        default n
        help
          Say Y here to enable Chipone charger status battery.

          If unsure, say N.

          To compile this dirver as a module, choose M here: the
          module will be called
```

## MTK_6.12/drivers/input/touchscreen/transsion/vendor/omnivision/td4160_common/Kconfig
```kconfig
#
# Omnivision TD4160 Touchscreen driver
#
config TRAN_TD4160_SPI
        tristate "CONFIG_TRAN_TD4160_SPI"
        default n
        help
      Say Y here if you have a Omnivision TD4160 touchscreen connected
      to your system.
          If unsure, say N.
          To compile this dirver as a module, choose M here: the
          module will be called.
```

## MTK_6.12/drivers/leds/tran_led/Kconfig
```kconfig
source "drivers/leds/tran_led/core/Kconfig"
source "drivers/leds/tran_led/aw2023/Kconfig"
source "drivers/leds/tran_led/tran_leds_hk32f0301/Kconfig"
#source "drivers/leds/tran_led/aw20144/Kconfig"
```

## MTK_6.12/drivers/leds/tran_led/aw20144/Kconfig
```kconfig
config TRAN_LED_CORE_AW20144
	tristate "LED Support for AW20144"
	help
	  this option enables support for the AW20144 RGB LED connected
	  through I2C. Say Y to enable support for the AW20144 LED
	  light automatically.
```

## MTK_6.12/drivers/leds/tran_led/core/Kconfig
```kconfig
config TRAN_LED_CORE
        tristate "enable tran led core"
    help
        If you need this func, set it to Y.
```
